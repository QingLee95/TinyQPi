## meta-tinyqpi/conf/layer.conf
```bitbake
# We have a conf and classes directory, append to BBPATH
BBPATH .= ":${LAYERDIR}"

# We have a recipes directory containing .bb and .bbappend files, add to BBFILES
BBFILES += "${LAYERDIR}/recipes*/*/*.bb \
            ${LAYERDIR}/recipes*/*/*.bbappend"

BBFILE_COLLECTIONS += "tinyqpi"
BBFILE_PATTERN_tinyqpi := "^${LAYERDIR}/"
BBFILE_PRIORITY_tinyqpi = "10"

LAYERSERIES_COMPAT_tinyqpi = "nanbield"
LAYERDEPENDS_tinyqpi = "raspberrypi chromium-browser-layer"
```
